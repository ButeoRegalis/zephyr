## drivers/display/Kconfig.ssd16xx
```kconfig
# SSD16XX display controller configuration options

# Copyright (c) 2018 Phytec Messtechnik GmbH
# Copyright (c) 2026, Dominic Hanssen (neutrondom@protonmail.com)
# SPDX-License-Identifier: Apache-2.0

config SSD16XX
	bool "SSD16XX compatible display controller driver"
	default y
	depends on \
		DT_HAS_SOLOMON_SSD1608_ENABLED || \
		DT_HAS_SOLOMON_SSD1673_ENABLED || \
		DT_HAS_SOLOMON_SSD1675A_ENABLED || \
		DT_HAS_SOLOMON_SSD1680_ENABLED || \
		DT_HAS_SOLOMON_SSD1681_ENABLED || \
		DT_HAS_SOLOMON_SSD1683_ENABLED
	select MIPI_DBI
	help
	  Enable driver for SSD16XX compatible controller.

config SSD16XX_NUM_CASCADED_CHIPS
	int "Number of cascaded ssd16xx chips"
	depends on SSD16XX
	range 1 2
	default 1
	help
	  Number of SSD16XX chips cascaded together. The more chips cascaded
	  the larger the supported display size. Set to 1 for a single 
	  chip (default). A maximum of 2 cascaded chips is currently supported.
```
